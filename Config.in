## package/Config.in
```kconfig
source "$BR2_EXTERNAL_CZECHLIGHT_PATH/package/cla-sysrepo/Config.in"
source "$BR2_EXTERNAL_CZECHLIGHT_PATH/package/czechlight-cfg-fs/Config.in"
source "$BR2_EXTERNAL_CZECHLIGHT_PATH/package/czechlight-clearfog-leds/Config.in"
source "$BR2_EXTERNAL_CZECHLIGHT_PATH/package/czechlight-rauc/Config.in"
source "$BR2_EXTERNAL_CZECHLIGHT_PATH/package/czechlight-separate-boot/Config.in"
source "$BR2_EXTERNAL_CZECHLIGHT_PATH/package/gammarus/Config.in"
source "$BR2_EXTERNAL_CZECHLIGHT_PATH/package/velia/Config.in"
source "$BR2_EXTERNAL_CZECHLIGHT_PATH/package/grub2-tools/Config.in"
source "$BR2_EXTERNAL_CZECHLIGHT_PATH/package/reset-sysrepo/Config.in"
source "$BR2_EXTERNAL_CZECHLIGHT_PATH/package/rousette/Config.in"
```

## package/cla-sysrepo/Config.in
```kconfig
config BR2_PACKAGE_CLA_SYSREPO
	bool "cla-sysrepo"
	select BR2_PACKAGE_SYSREPO_CPP
	select BR2_PACKAGE_LIBYANG_CPP
	select BR2_PACKAGE_DOCOPT_CPP
	select BR2_PACKAGE_SPDLOG
	select BR2_PACKAGE_SYSTEMD
	select BR2_PACKAGE_LIBGPIOD
	select BR2_PACKAGE_BOOST
	select BR2_PACKAGE_LIBEV
	select BR2_PACKAGE_CZECHLIGHT_CFG_FS
	select BR2_PACKAGE_DATE
	help
	  Control CzechLight devices over YANG with sysrepo
```

## package/czechlight-cfg-fs/Config.in
```kconfig
config BR2_PACKAGE_CZECHLIGHT_CFG_FS
	bool "Prepare persistent /cfg partition and /etc overlay. Install required YANG models."
	depends on BR2_INIT_SYSTEMD
	depends on BR2_PACKAGE_NETOPEER2
	select BR2_PACKAGE_HOST_JQ
	select BR2_PACKAGE_JQ
	help
	  This is required for RAUC to work properly.  It creates a blank FS
	  image, configures systemd to mount it, and ensures that its contents
	  get restored to /etc at boot.  The /etc is set up as a RW overlay on
	  top of a read-only rootfs.
	  This takes care of installing YANG files used by czechlight system
	  daemons into sysrepo.

if BR2_PACKAGE_CZECHLIGHT_CFG_FS

config CZECHLIGHT_CFG_FS_SIZE
	string "exact size"
	default "128M"
	help
	  Size of the /cfg filesystem image.  This must be big enough to
	  accommodate all configuration, but small enough to fit within the
	  corresponding partition.

endif # BR2_PACKAGE_CZECHLIGHT_CFG_FS
```

## package/czechlight-clearfog-leds-boot/Config.in
```kconfig
config BR2_PACKAGE_CZECHLIGHT_CLEARFOG_LEDS_BOOT
	bool "Indicate a successful boot via LEDs"
	depends on CZECHLIGHT_RAUC_ROOTFS
	depends on BR2_INIT_SYSTEMD
```

## package/czechlight-clearfog-leds/Config.in
```kconfig
config BR2_PACKAGE_CZECHLIGHT_CLEARFOG_LEDS
	bool "LED functions for Clearfog-based CzechLight devices"
	depends on BR2_INIT_SYSTEMD
	help
	  Userspace configuration of LEDs for indicating various states.
```

## package/czechlight-install-yang/Config.in
```kconfig
config BR2_PACKAGE_CZECHLIGHT_INSTALL_YANG
	bool "Install YANG files required by CzechLight SW into sysrepo"
	depends on BR2_INIT_SYSTEMD
	depends on BR2_PACKAGE_NETOPEER2
	depends on BR2_PACKAGE_CZECHLIGHT_CFG_FS
	help
	  This takes care of installing YANG files used by czechlight daemons
	  into sysrepo.
```

## package/czechlight-power/Config.in
```kconfig
config BR2_PACKAGE_CZECHLIGHT_POWER
	bool "Dynamic power supply loading"
	depends on BR2_INIT_SYSTEMD
	help
	  Userspace script which dynamically loads drivers for power supplies
```

## package/czechlight-rauc/Config.in
```kconfig
config CZECHLIGHT_RAUC_ROOTFS
	bool "Create RAUC update bundle"
	depends on BR2_INIT_SYSTEMD
	depends on BR2_PACKAGE_RAUC
	select BR2_PACKAGE_CZECHLIGHT_CFG_FS
	select BR2_PACKAGE_HOST_RAUC
	select BR2_PACKAGE_CZECHLIGHT_RAUC

if CZECHLIGHT_RAUC_ROOTFS

config CZECHLIGHT_RAUC_COMPATIBLE
	string "HW compatibility string"
	help
	  Unique identifier which specifies what boards accept a given SW image.

config BR2_PACKAGE_CZECHLIGHT_RAUC
	bool

config CZECHLIGHT_RAUC_BOOTLOADER
	string
	default uboot if BR2_TARGET_UBOOT
	default grub if BR2_TARGET_GRUB2

config CZECHLIGHT_RAUC_SLOT_A_ROOTFS_DEV
	string "device name (rootfs slot A)"
	help
	  Name of the device/partition where rootfs for slot A will be

config CZECHLIGHT_RAUC_SLOT_A_CFG_DEV
	string "device name (cfg slot A)"
	help
	  Name of the device/partition where cfg for slot A will be

config CZECHLIGHT_RAUC_SLOT_B_ROOTFS_DEV
	string "device name (rootfs slot B)"
	help
	  Name of the device/partition where rootfs for slot B will be

config CZECHLIGHT_RAUC_SLOT_B_CFG_DEV
	string "device name (cfg slot B)"
	help
	  Name of the device/partition where cfg for slot B will be

endif # CZECHLIGHT_RAUC_ROOTFS
```

## package/czechlight-separate-boot/Config.in
```kconfig
config BR2_TARGET_ROOTFS_CZECHLIGHT_SEPARATE_BOOT
	bool "Separate /boot partition"
	select BR2_PACKAGE_CZECHLIGHT_SEPARATE_BOOT
	help
	  Builds a standalone ext2 image with the /boot directory from the real rootfs.

if BR2_TARGET_ROOTFS_CZECHLIGHT_SEPARATE_BOOT

config BR2_PACKAGE_CZECHLIGHT_SEPARATE_BOOT
	bool

config CZECHLIGHT_SEPARATE_BOOT_SIZE
	string "exact size"
	default "4M"
	help
	  Size of the /boot filesystem image.

endif # BR2_TARGET_ROOTFS_CZECHLIGHT_SEPARATE_BOOT
```

## package/czechlight-webui/Config.in
```kconfig
config BR2_PACKAGE_CZECHLIGHT_WEBUI
	bool "Czechlight web interface"
	select BR2_PACKAGE_NGHTTP2
	help
	  Client-side JS app for monitoring CzechLight devices.

	  https://gitlab.cesnet.cz/705/czl-sdn/czl-sdn-web-ui
```

## package/gammarus/Config.in
```kconfig
config BR2_PACKAGE_GAMMARUS
	bool "gammarus"
	select BR2_PACKAGE_NGHTTP2_APPS
	help
	  Web dashboard for CzechLight devices
```

## package/grub2-tools/Config.in
```kconfig
config BR2_PACKAGE_GRUB2_TOOLS
	bool "grub2-tools"
	depends on BR2_USE_WCHAR
	help
	  Support tools to interact with GNU GRUB Multiboot boot loader.

	  http://www.gnu.org/software/grub/

comment "grub2-tools needs a toolchain w/ wchar"
	depends on !BR2_USE_WCHAR
```

## package/kwboot/Config.in
```kconfig
config BR2_PACKAGE_KWBOOT
	bool "kwboot"
	depends on BR2_TARGET_UBOOT
	help
	  Build kwboot from uboot-tools
```

## package/kwboot/Config.in.host
```kconfig
config BR2_PACKAGE_HOST_KWBOOT
	bool "host kwboot"
	select BR2_PACKAGE_HOST_OPENSSL
	select BR2_PACKAGE_HOST_UTIL_LINUX
	help
	  Build kwboot from uboot-tools for the host
```

## package/lldp-systemd-networkd-sysrepo/Config.in
```kconfig
config BR2_PACKAGE_LLDP_SYSTEMD_NETWORKD_SYSREPO
	bool "lldp-systemd-networkd-sysrepo"
	select BR2_PACKAGE_SPDLOG
	select BR2_PACKAGE_SDBUS_CPP
	select BR2_PACKAGE_SYSTEMD
	select BR2_PACKAGE_SYSREPO
	select BR2_PACKAGE_SYSREPO_CPP
	help
	  lldp-systemd-networkd-sysrepo is a sysrepo application announcing LLDP neighbours from systemd-networkd.

	  https://gerrit.cesnet.cz/q/project:CzechLight/lldp-systemd-networkd-sysrepo
```

## package/rauc-system-conf/Config.in
```kconfig
config BR2_PACKAGE_RAUC_SYSTEM_CONF
	bool "rauc-system-conf"
	depends on BR2_PACKAGE_RAUC
	help
	  Install a standardized system.conf RAUC config into /etc/rauc/system.conf

	  This standardized config supports two symmetric slots (A and B) for rootfs.
	  For both of these slots, there is another slot cfg for persistent data.

	  This package requires you to fill the names of devices for all four slots.
	  Based on them, the correct system.conf will be generated and installed.

if BR2_PACKAGE_RAUC_SYSTEM_CONF

config CZECHLIGHT_RAUC_SLOT_A_ROOTFS_DEV
	string "device name (rootfs slot A)"
	help
	  Name of the device/partition where rootfs for slot A will be
config CZECHLIGHT_RAUC_SLOT_A_CFG_DEV
	string "device name (cfg slot A)"
	help
	  Name of the device/partition where cfg for slot A will be
config CZECHLIGHT_RAUC_SLOT_B_ROOTFS_DEV
	string "device name (rootfs slot B)"
	help
	  Name of the device/partition where rootfs for slot B will be
config CZECHLIGHT_RAUC_SLOT_B_CFG_DEV
	string "device name (cfg slot B)"
	help
	  Name of the device/partition where cfg for slot B will be

endif # BR2_PACKAGE_RAUC_SYSTEM_CONF
```

## package/reset-sysrepo/Config.in
```kconfig
config BR2_PACKAGE_RESET_SYSREPO
	bool "Override and re-init sysrepo's /dev/shm"
	help
	  If enabled, configure sysrepo to use /run/sysrepo instead of
	  /dev/shm, and reinitialize that filesystem with a fresh tmpfs upon
	  restart of any sysrepo-using service.
```
