## package/rousette/Config.in
```kconfig
config BR2_PACKAGE_ROUSETTE
	bool "rousette"
	select BR2_PACKAGE_BOOST
	select BR2_PACKAGE_DOCOPT_CPP
	select BR2_PACKAGE_LIBYANG_CPP
	select BR2_PACKAGE_NGHTTP2
	select BR2_PACKAGE_NGHTTP2_CXX
	select BR2_PACKAGE_SPDLOG
	select BR2_PACKAGE_SYSTEMD
	select BR2_PACKAGE_SYSREPO_CPP
	help
	  RESTCONF-ish server on top of sysrepo

	  https://gerrit.cesnet.cz/q/project:CzechLight/rousette
```

## package/sdbus-cpp/Config.in
```kconfig
config BR2_PACKAGE_SDBUS_CPP
	bool "sdbus-cpp"
	select BR2_PACKAGE_SYSTEMD
	help
	  TODO SOME DESCRIPTION STRING
```

## package/sfp-i2c/Config.in
```kconfig
config BR2_PACKAGE_SFP_I2C
	bool "sfp-i2c"
	help
	  Read the data of an SFP(+)-module and print it pretty
```

## package/sysrepo-group/Config.in
```kconfig
config BR2_PACKAGE_SYSREPO_GROUP
	bool "Override group for processes running sysrepo"
	help
	  If enabled, configure sysrepo to use /run/sysrepo instead of
	  /dev/shm, and reinitialize that filesystem with a fresh tmpfs upon
	  restart of any sysrepo-using service.
```

## package/sysrepo-ietf-alarms/Config.in
```kconfig
config BR2_PACKAGE_SYSREPO_IETF_ALARMS
	bool "velia"
	select BR2_PACKAGE_DOCOPT_CPP
	select BR2_PACKAGE_SPDLOG
	select BR2_PACKAGE_SYSREPO
	select BR2_PACKAGE_SYSREPO_CPP
	select BR2_PACKAGE_CZECHLIGHT_CFG_FS
	select BR2_PACKAGE_DATE
	help
	  Implementing the `ietf-alarms` YANG module for sysrepo.

	  https://gerrit.cesnet.cz/q/project:CzechLight/sysrepo-ietf-alarms
```

## package/velia/Config.in
```kconfig
config BR2_PACKAGE_VELIA
	bool "velia"
	select BR2_PACKAGE_DOCOPT_CPP
	select BR2_PACKAGE_LIBNL
	select BR2_PACKAGE_SPDLOG
	select BR2_PACKAGE_BOOST
	select BR2_PACKAGE_SDBUS_CPP
	select BR2_PACKAGE_SYSTEMD
	select BR2_PACKAGE_SYSREPO
	select BR2_PACKAGE_SYSREPO_CPP
	select BR2_PACKAGE_JSON_FOR_MODERN_CPP
	help
	  Health tracking for embedded devices running Linux

	  https://gerrit.cesnet.cz/q/project:CzechLight/velia
```
